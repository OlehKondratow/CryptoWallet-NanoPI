## meta-cryptowallet/conf/layer.conf
```bitbake
# We have a conf and classes directory, add to BBPATH
BBPATH .= ":${LAYERDIR}"

# We have recipes-* directories, add to BBFILES
BBFILES += "${LAYERDIR}/recipes-*/*/*.bb \
            ${LAYERDIR}/recipes-*/*/*.bbappend"

BBFILE_COLLECTIONS += "cryptowallet"
BBFILE_PATTERN_cryptowallet = "^${LAYERDIR}/"
BBFILE_PRIORITY_cryptowallet = "7"

LAYERDEPENDS_cryptowallet = "core openembedded-layer meta-python meta-networking"
LAYERSERIES_COMPAT_cryptowallet = "scarthgap"
```
